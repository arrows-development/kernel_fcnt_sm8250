/*
 * FCNT arrows 5G (F-51A) base DTB - Qualcomm kona v2 SoC
 */

/dts-v1/;

#include "../vendor/qcom/kona-v2.dtsi"

#include "amaterasu/amaterasu-soc.dtsi"
#include "amaterasu/amaterasu-pstore.dtsi"

/ {
	model = "Qualcomm Technologies, Inc. kona v2 SoC";
	compatible = "qcom,kona";
	qcom,board-id = <0 0>;
};
