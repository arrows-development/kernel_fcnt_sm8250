/*
 * FCNT arrows 5G (F-51A) base DTB - Qualcomm kona v1 SoC
 */

/dts-v1/;

#include "../vendor/qcom/kona.dtsi"

#include "amaterasu/amaterasu-soc.dtsi"
#include "amaterasu/amaterasu-pstore.dtsi"

/ {
	model = "Qualcomm Technologies, Inc. kona v1 SoC";
	compatible = "qcom,kona";
	qcom,board-id = <0 0>;
};
