/*
 * FCNT arrows 5G (F-51A) - Audio: sound card routing, WSA speakers and tertiary MI2S pinctrl.
 *
 * Reconstructed from the FCNT stock dtbo (kona FFRD REV7 SKU3); FFRD is
 * derived from the CLO kona QRD board files.
 */

&kona_snd {
	qcom,model = "kona-qrd-snd-card";
	qcom,audio-routing = "AMIC2", "MIC BIAS2", "MIC BIAS2", "Analog Mic2", "TX DMIC0", "MIC BIAS3", "MIC BIAS3", "Digital Mic0", "TX DMIC1", "MIC BIAS3", "MIC BIAS3", "Digital Mic1", "TX DMIC2", "MIC BIAS1", "MIC BIAS1", "Digital Mic2", "TX DMIC3", "MIC BIAS1", "MIC BIAS1", "Digital Mic3", "TX DMIC5", "MIC BIAS4", "MIC BIAS4", "Digital Mic5", "IN1_HPHL", "HPHL_OUT", "IN2_HPHR", "HPHR_OUT", "IN3_AUX", "AUX_OUT", "TX SWR_ADC0", "ADC1_OUTPUT", "TX SWR_ADC1", "ADC2_OUTPUT", "TX SWR_ADC2", "ADC3_OUTPUT", "TX SWR_ADC3", "ADC4_OUTPUT", "TX SWR_DMIC0", "DMIC1_OUTPUT", "TX SWR_DMIC1", "DMIC2_OUTPUT", "TX SWR_DMIC2", "DMIC3_OUTPUT", "TX SWR_DMIC3", "DMIC4_OUTPUT", "TX SWR_DMIC4", "DMIC5_OUTPUT", "TX SWR_DMIC5", "DMIC6_OUTPUT", "TX SWR_DMIC6", "DMIC7_OUTPUT", "TX SWR_DMIC7", "DMIC8_OUTPUT", "WSA SRC0_INP", "SRC0", "WSA_TX DEC0_INP", "TX DEC0 MUX", "WSA_TX DEC1_INP", "TX DEC1 MUX", "RX_TX DEC0_INP", "TX DEC0 MUX", "RX_TX DEC1_INP", "TX DEC1 MUX", "RX_TX DEC2_INP", "TX DEC2 MUX", "RX_TX DEC3_INP", "TX DEC3 MUX", "SpkrLeft IN", "WSA_SPK1 OUT", "SpkrRight IN", "WSA_SPK2 OUT", "VA_AIF1 CAP", "VA_SWR_CLK", "VA_AIF2 CAP", "VA_SWR_CLK", "VA_AIF3 CAP", "VA_SWR_CLK", "VA MIC BIAS3", "Digital Mic0", "VA MIC BIAS3", "Digital Mic1", "VA MIC BIAS1", "Digital Mic2", "VA MIC BIAS1", "Digital Mic3", "VA MIC BIAS4", "Digital Mic5", "VA DMIC0", "VA MIC BIAS3", "VA DMIC1", "VA MIC BIAS3", "VA DMIC2", "VA MIC BIAS1", "VA DMIC3", "VA MIC BIAS1", "VA DMIC5", "VA MIC BIAS4", "VA SWR_ADC1", "VA_SWR_CLK", "VA SWR_MIC0", "VA_SWR_CLK", "VA SWR_MIC1", "VA_SWR_CLK", "VA SWR_MIC2", "VA_SWR_CLK", "VA SWR_MIC3", "VA_SWR_CLK", "VA SWR_MIC4", "VA_SWR_CLK", "VA SWR_MIC5", "VA_SWR_CLK", "VA SWR_MIC6", "VA_SWR_CLK", "VA SWR_MIC7", "VA_SWR_CLK", "VA SWR_MIC0", "DMIC1_OUTPUT", "VA SWR_MIC1", "DMIC2_OUTPUT", "VA SWR_MIC2", "DMIC3_OUTPUT", "VA SWR_MIC3", "DMIC4_OUTPUT", "VA SWR_MIC4", "DMIC5_OUTPUT", "VA SWR_MIC5", "DMIC6_OUTPUT", "VA SWR_MIC6", "DMIC7_OUTPUT", "VA SWR_MIC7", "DMIC8_OUTPUT", "VA SWR_ADC1", "ADC2_OUTPUT";
	qcom,msm-mbhc-hphl-swh = <0>;
	qcom,msm-mbhc-gnd-swh = <0>;
	qcom,msm-mbhc-usbc-audio-supported = <1>;
};

&dai_mi2s2 {
	qcom,msm-mi2s-tx-lines = <1>;
	pinctrl-names = "default", "sleep";
	pinctrl-0 = <&tert_mi2s_sck_active &tert_mi2s_ws_active &tert_mi2s_sd0_active>;
	pinctrl-1 = <&tert_mi2s_sck_sleep &tert_mi2s_ws_sleep &tert_mi2s_sd0_sleep>;
};
