/*
 * FCNT arrows 5G (F-51A) - persistent RAM (ramoops) layout.
 *
 * FCNT configures ramoops via the kernel command line; the 3MB buffer at
 * 0xb9500000 is reserved early by arch/arm64/mm/mmu.c (FCNT LogImprovement).
 * smry_size is the FCNT pstore summary zone (CONFIG_PSTORE_SUMMARY).
 */

/ {
	chosen {
		bootargs = "rcupdate.rcu_expedited=1 rcu_nocbs=0-7 kpti=off ramoops.mem_address=0xB9500000 ramoops.mem_size=0x300000 ramoops.console_size=0x80000 ramoops.smry_size=0x1000 ramoops.pmsg_size=0x200000 ramoops.ftrace_size=0x0 ramoops.record_size=0x40000 ramoops.dump_oops=1 ignore_loglevel=1";
	};
};
