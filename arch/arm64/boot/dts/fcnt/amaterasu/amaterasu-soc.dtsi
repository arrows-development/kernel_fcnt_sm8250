/*
 * FCNT arrows 5G (F-51A) - SoC level changes on top of the CLO kona base.
 *
 * FCNT's TrustZone/QSEE images need larger carve-outs than the CLO default:
 * removed_region grows by 4MB and the QSEECOM region/heap by 16MB.
 */

&removed_mem {
	reg = <0x0 0x80b00000 0x0 0x5700000>;
};

&qseecom_mem {
	size = <0x0 0x2400000>;
};

&qcom_seecom {
	reg = <0x82400000 0x3e00000>;
};
